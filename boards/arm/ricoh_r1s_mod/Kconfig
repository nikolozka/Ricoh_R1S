## boards/arm/ricoh_r1s_mod/Kconfig
```kconfig
# ricoh_r1s board configuration

# Copyright (c) 2020 Nordic Semiconductor ASA
# SPDX-License-Identifier: Apache-2.0

config BOARD_ENABLE_DCDC
	bool "DCDC mode"
	select SOC_DCDC_NRF52X
	default n
	depends on BOARD_RICOH_R1S
```

## boards/arm/ricoh_r1s_mod/Kconfig.board
```kconfig
# Copyright (c) 2023 Nordic Semiconductor ASA
# SPDX-License-Identifier: Apache-2.0

config BOARD_RICOH_R1S_MOD
	bool "ricoh_r1s_mod"
	depends on SOC_NRF52832_QFAA
```

## boards/arm/ricoh_r1s_mod/Kconfig.defconfig
```kconfig
# Copyright (c) 2023 Nordic Semiconductor ASA
# SPDX-License-Identifier: Apache-2.0

if BOARD_RICOH_R1S_MOD

config BOARD
	default "ricoh_r1s_mod"

config BT_CTLR
   default BT

endif
```

## boards/arm/ricoh_r1s_mod/ricoh_r1s_mod_defconfig
```kconfig
# Copyright (c) 2023 Nordic Semiconductor ASA
# SPDX-License-Identifier: Apache-2.0

CONFIG_SOC_SERIES_NRF52X=y
CONFIG_SOC_NRF52832_QFAA=y
CONFIG_BOARD_RICOH_R1S_MOD=y

# Enable MPU
CONFIG_ARM_MPU=y

# Enable hardware stack protection
CONFIG_HW_STACK_PROTECTION=y

CONFIG_BOARD_ENABLE_DCDC=n
CONFIG_NFCT_PINS_AS_GPIOS=y

CONFIG_CLOCK_CONTROL_NRF_K32SRC_RC=y
CONFIG_CLOCK_CONTROL_NRF_K32SRC_500PPM=y
CONFIG_CLOCK_CONTROL_NRF_K32SRC_RC_CALIBRATION=y
CONFIG_CLOCK_CONTROL_NRF_CALIBRATION_LF_ALWAYS_ON=y

CONFIG_PINCTRL=y
```
